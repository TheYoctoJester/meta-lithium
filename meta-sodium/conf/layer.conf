## meta-sodium/conf/layer.conf
```bitbake
# We have a conf and classes directory, add to BBPATH
BBPATH .= ":${LAYERDIR}"

# We have recipes-* directories, add to BBFILES
BBFILES += "${LAYERDIR}/recipes-*/*/*.bb \
            ${LAYERDIR}/recipes-*/*/*.bbappend"

BBFILE_COLLECTIONS += "meta-sodium"
BBFILE_PATTERN_meta-sodium = "^${LAYERDIR}/"
BBFILE_PRIORITY_meta-sodium = "6"

LAYERDEPENDS_meta-sodium = "core"
LAYERSERIES_COMPAT_meta-sodium = "gatesgarth"
```
